## MLPerf_ESP32-S3/sdkconfig.defaults
```kconfig
# --- PSRAM (Externer RAM) Aktivierung ---
CONFIG_SPIRAM=y
CONFIG_SPIRAM_MODE_OCT=y
CONFIG_SPIRAM_SPEED_80M=y
# Erlaubt malloc(), den PSRAM automatisch zu nutzen
CONFIG_SPIRAM_USE_MALLOC=y
# Erlaubt Stack im PSRAM (wichtig für große Tasks)
CONFIG_SPIRAM_ALLOW_STACK_EXTERNAL_MEMORY=y
# Hack: Cache Workaround für S3
CONFIG_SPIRAM_CACHE_WORKAROUND=y

# --- USB Serial JTAG Konsole ---
CONFIG_ESP_CONSOLE_USB_SERIAL_JTAG=y
CONFIG_ESP_CONSOLE_SECONDARY_NONE=y
CONFIG_ESP_CONSOLE_UART_DEFAULT=n
CONFIG_ESP_CONSOLE_UART0_DEFAULT=n

# --- WiFi/BT aus (Speicher sparen) ---
CONFIG_BT_ENABLED=n
CONFIG_WIFI_ENABLED=n
```

## MLPerf_ESP32-Wroom-32/sdkconfig.defaults
```kconfig
# Deaktiviere WiFi und Bluetooth komplett um RAM zu sparen
CONFIG_BT_ENABLED=n
CONFIG_WIFI_ENABLED=n

# Optimiere Newlib (Standard C Library) für Speicher
CONFIG_NEWLIB_NANO_FORMAT=y

# (Optional) Erhöhe die Main Task Stack Size etwas, falls nötig
CONFIG_ESP_MAIN_TASK_STACK_SIZE=4096
```
