
// Benötigte C/C++ Header
#include <stdio.h>
#include <string.h>
#include <esp_timer.h>

// Benötigte ESP-IDF / FreeRTOS Header
#include "esp_log.h"
#include "freertos/FreeRTOS.h"
#include "freertos/task.h"

// Benötigte Header für die native TFLM API (bleiben gleich)
#include "tensorflow/lite/micro/micro_interpreter.h"
#include "tensorflow/lite/micro/micro_mutable_op_resolver.h"
#include "tensorflow/lite/schema/schema_generated.h"

// Dein konvertiertes Modell und die Testdaten (bleiben gleich)
#include "model_data_2.h"

// Input ist ein 28x28 Pixel großes Bild
constexpr int kInputSize = 28 * 28;
// Output sind 10 "Wahrscheinlichkeiten" für die Ziffern 0-9
constexpr int kOutputSize = 10;
// Die Tensor Arena muss groß genug sein.
constexpr int kTensorArenaSize = 60 * 1024;

// Buffer für die Tensor Arena
uint8_t* tensor_arena = nullptr;

// Globale Variablen für das TFLM-Setup
const tflite::Model* model = nullptr;
tflite::MicroInterpreter* interpreter = nullptr;
TfLiteTensor* input = nullptr;
TfLiteTensor* output = nullptr;

float sample_digit_2[784] = {
    0.000000f, 0.000000f, 0.000000f, 0.000000f, 0.000000f, 0.000000f, 0.000000f, 0.000000f, 0.000000f, 0.000000f, 0.000000f, 0.000000f, 0.000000f, 0.000000f, 
    0.000000f, 0.000000f, 0.000000f, 0.000000f, 0.000000f, 0.000000f, 0.000000f, 0.000000f, 0.000000f, 0.000000f, 0.000000f, 0.000000f, 0.000000f, 0.000000f, 
    0.000000f, 0.000000f, 0.000000f, 0.000000f, 0.000000f, 0.000000f, 0.000000f, 0.000000f, 0.000000f, 0.000000f, 0.000000f, 0.000000f, 0.000000f, 0.000000f, 
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    0.000000f, 0.000000f, 0.000000f, 0.000000f, 0.000000f, 0.000000f, 0.000000f, 0.000000f, 0.000000f, 0.000000f, 0.000000f, 0.000000f, 0.000000f, 0.000000f
};

float sample_digit_6[784] = {
    0.000000f, 0.000000f, 0.000000f, 0.000000f, 0.000000f, 0.000000f, 0.000000f, 0.000000f, 0.000000f, 0.000000f, 0.000000f, 0.000000f, 0.000000f, 0.000000f, 
    0.000000f, 0.000000f, 0.000000f, 0.000000f, 0.000000f, 0.000000f, 0.000000f, 0.000000f, 0.000000f, 0.000000f, 0.000000f, 0.000000f, 0.000000f, 0.000000f, 
    0.000000f, 0.000000f, 0.000000f, 0.000000f, 0.000000f, 0.000000f, 0.000000f, 0.000000f, 0.000000f, 0.000000f, 0.000000f, 0.000000f, 0.000000f, 0.000000f, 
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    0.000000f, 0.000000f, 0.000000f, 0.000000f, 0.000000f, 0.000000f, 0.000000f, 0.000000f, 0.000000f, 0.000000f, 0.000000f, 0.000000f, 0.000000f, 0.000000f
};

float sample_digit_7[784] = {
    0.000000f, 0.000000f, 0.000000f, 0.000000f, 0.000000f, 0.000000f, 0.000000f, 0.000000f, 0.000000f, 0.000000f, 0.000000f, 0.000000f, 0.000000f, 0.000000f, 
    0.000000f, 0.000000f, 0.000000f, 0.000000f, 0.000000f, 0.000000f, 0.000000f, 0.000000f, 0.000000f, 0.000000f, 0.000000f, 0.000000f, 0.000000f, 0.000000f, 
    0.000000f, 0.000000f, 0.000000f, 0.000000f, 0.000000f, 0.000000f, 0.000000f, 0.000000f, 0.000000f, 0.000000f, 0.000000f, 0.000000f, 0.000000f, 0.000000f, 
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    0.000000f, 0.000000f, 0.000000f, 0.000000f, 0.000000f, 0.000000f, 0.000000f, 0.000000f, 0.000000f, 0.000000f, 0.000000f, 0.000000f, 0.000000f, 0.000000f
};

// Test-Samples und die korrekten Antworten
float* test_samples[] = { sample_digit_2, sample_digit_6, sample_digit_7};
const int correct_labels[] = { 2, 6, 7 };


// TAG für das ESP-IDF Logging-System
static const char* TAG = "MNIST_CLASSIFIER";

extern "C" void app_main(void)
{
    vTaskDelay(2000 / portTICK_PERIOD_MS);
    
    ESP_LOGI(TAG, "╔════════════════════════════════════════╗");
    ESP_LOGI(TAG, "║  ESP32 TinyML - MNIST Ziffernerkennung ║");
    ESP_LOGI(TAG, "╚════════════════════════════════════════╝\n");
    
    ESP_LOGI(TAG, "⏳ Lade TensorFlow Lite Modell...");
    
    // 1. Lade das Modell aus dem C-Array
    model = tflite::GetModel(mnist_cnn_tflite); 
    if (model->version() != TFLITE_SCHEMA_VERSION) {
        ESP_LOGE(TAG, "❌ FEHLER: Modell-Version ist inkompatibel!");
        while (1) vTaskDelay(100);
    }

    // 2. Erstelle den OpResolver (Deine Version hatte 4, aber es sind 6 Operatoren)
    tflite::MicroMutableOpResolver<9> op_resolver;

    if (op_resolver.AddShape() != kTfLiteOk) { ESP_LOGE(TAG, "Fehler bei AddShapee"); return; }
    if (op_resolver.AddStridedSlice() != kTfLiteOk) { ESP_LOGE(TAG, "Fehler bei AddStridedSlice"); return; }
    if (op_resolver.AddPack() != kTfLiteOk) { ESP_LOGE(TAG, "Fehler bei AddPack"); return; }
    if (op_resolver.AddConv2D() != kTfLiteOk) { ESP_LOGE(TAG, "Fehler bei AddConv2D"); return; }
    if (op_resolver.AddRelu() != kTfLiteOk) { ESP_LOGE(TAG, "Fehler bei AddRelu"); return; }
    if (op_resolver.AddMaxPool2D() != kTfLiteOk) { ESP_LOGE(TAG, "Fehler bei AddMaxPool2D"); return; }
    if (op_resolver.AddReshape() != kTfLiteOk) { ESP_LOGE(TAG, "Fehler bei AddReshape"); return; }
    if (op_resolver.AddFullyConnected() != kTfLiteOk) { ESP_LOGE(TAG, "Fehler bei AddFullyConnected"); return; }
    if (op_resolver.AddSoftmax() != kTfLiteOk) { ESP_LOGE(TAG, "Fehler bei AddSoftmax"); return; }

    tensor_arena = (uint8_t*) malloc(kTensorArenaSize);
    if (tensor_arena == nullptr) {
        ESP_LOGE(TAG, "❌ FEHLER: Konnte die Tensor Arena auf dem Heap nicht allozieren!");
        return; // Programm hier beenden
    }
    ESP_LOGI(TAG, "✓ Tensor Arena (%d Bytes) erfolgreich auf dem Heap alloziert.", kTensorArenaSize);


    // 3. Erstelle den Interpreter
    static tflite::MicroInterpreter static_interpreter(model, op_resolver, tensor_arena, kTensorArenaSize);
    interpreter = &static_interpreter;

    // 4. Reserviere den Speicher (Tensor Arena)
    if (interpreter->AllocateTensors() != kTfLiteOk) {
        ESP_LOGE(TAG, "❌ FEHLER: AllocateTensors() fehlgeschlagen!");
        while (1) vTaskDelay(100);
    }

    // 5. Hole Zeiger auf die Ein- und Ausgabe-Tensoren
    input = interpreter->input(0);
    output = interpreter->output(0);
    
    ESP_LOGI(TAG, "✓ Modell erfolgreich geladen!\n");
    
    // Validierungs-Tests
    ESP_LOGI(TAG, "🧪 Validierungs-Tests:\n");
    ESP_LOGI(TAG, "━━━━━━━━━━━━━━━━━━━━━━━━━━━━━━━━━━━━━━━━━━━━━━━━━━━━━━━━━━━━━━━━━━━━");
    ESP_LOGI(TAG, "  Testfall  │  Vorhergesagt  │  Korrekt?   │  Inferenzzeit (µs) ");
    ESP_LOGI(TAG, "━━━━━━━━━━━━━━━━━━━━━━━━━━━━━━━━━━━━━━━━━━━━━━━━━━━━━━━━━━━━━━━━━━━━");
    
    int correct_predictions = 0;
    int num_tests = sizeof(correct_labels) / sizeof(correct_labels[0]);

    for (int i = 0; i < num_tests; i++) {
        memcpy(input->data.f, test_samples[i], kInputSize * sizeof(float));

        // ===================================================================
        // HIER STARTET DIE ZEITMESSUNG
        // ===================================================================
        int64_t start_time = esp_timer_get_time();

        if (interpreter->Invoke() != kTfLiteOk) {
            ESP_LOGE(TAG, "❌ FEHLER: Invoke() fehlgeschlagen!");
            continue;
        }

        // ===================================================================
        // HIER ENDET DIE ZEITMESSUNG
        // ===================================================================
        int64_t end_time = esp_timer_get_time();
        int64_t inference_time = end_time - start_time;


        int predicted_digit = -1;
        float max_probability = 0.0;
        for (int j = 0; j < kOutputSize; j++) {
            float current_prob = output->data.f[j];
            if (current_prob > max_probability) {
                max_probability = current_prob;
                predicted_digit = j;
            }
        }
        
        bool is_correct = (predicted_digit == correct_labels[i]);
        if (is_correct) {
            correct_predictions++;
        }

        // NEU: Gib die gemessene Zeit in der Tabelle aus
        ESP_LOGI(TAG, "    Ziffer %d   │       %d        │     %s      │  %lld", 
                     correct_labels[i], predicted_digit, is_correct ? "Ja ✓ " : "Nein ❌", inference_time);
    }

    ESP_LOGI(TAG, "━━━━━━━━━━━━━━━━━━━━━━━━━━━━━━━━━━━━━━━━━━━━━━━━━━━━━━━━━━━━━━━━━━━━");
    float accuracy = (float)correct_predictions / num_tests * 100.0;
    ESP_LOGI(TAG, "\n📊 Genauigkeit: %.2f%% (%d von %d korrekt)\n\n", accuracy, correct_predictions, num_tests);

    ESP_LOGI(TAG, "╔════════════════════════════════════════╗");
    ESP_LOGI(TAG, "║  ✓ Testdurchlauf abgeschlossen!        ║");
    ESP_LOGI(TAG, "╚════════════════════════════════════════╝\n");

    // Entspricht der leeren loop() Funktion
    while(1) {
        vTaskDelay(1000 / portTICK_PERIOD_MS);
    }
}